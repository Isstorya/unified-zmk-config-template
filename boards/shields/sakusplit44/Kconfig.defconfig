## boards/shields/sakusplit44/Kconfig.defconfig
```kconfig
if SHIELD_SAKUSPLIT44_QUBE || SHIELD_SAKUSPLIT44_LEFT

config ZMK_KEYBOARD_NAME
    default "SAKUSPLIT44"

config ZMK_SPLIT_ROLE_CENTRAL
    default y

endif

if SHIELD_SAKUSPLIT44_QUBE || SHIELD_SAKUSPLIT44_LEFT_QUBE || SHIELD_SAKUSPLIT44_LEFT || SHIELD_SAKUSPLIT44_RIGHT

config ZMK_SPLIT
    default y

endif
```

## boards/shields/sakusplit44/Kconfig.shield
```kconfig
# SPDX-License-Identifier: MIT
config SHIELD_SAKUSPLIT44_LEFT
  def_bool $(shields_list_contains,sakusplit44_left)

config SHIELD_SAKUSPLIT44_RIGHT
  def_bool $(shields_list_contains,sakusplit44_right)
```
