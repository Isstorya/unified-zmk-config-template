#include "sakusplit44.dtsi"

&kscan0 {
    compatible = "zmk,kscan-gpio-matrix";

    col-gpios =
        <&gpio0 31 GPIO_ACTIVE_HIGH>, /* D21 */
        <&gpio0 29 GPIO_ACTIVE_HIGH>, /* D20 */
        <&gpio0  2 GPIO_ACTIVE_HIGH>, /* D19 */
        <&gpio1 15 GPIO_ACTIVE_HIGH>, /* D18 */
        <&gpio1 13 GPIO_ACTIVE_HIGH>, /* D15 */
        <&gpio1 11 GPIO_ACTIVE_HIGH>; /* D14 */

    row-gpios =
        <&gpio0  6 (GPIO_ACTIVE_HIGH | GPIO_PULL_DOWN)>, /* D1 */
        <&gpio0  8 (GPIO_ACTIVE_HIGH | GPIO_PULL_DOWN)>, /* D0 */
        <&gpio0 20 (GPIO_ACTIVE_HIGH | GPIO_PULL_DOWN)>, /* D2 */
        <&gpio0 17 (GPIO_ACTIVE_HIGH | GPIO_PULL_DOWN)>; /* D3 */

};

&right_encoder { status = "okay"; };
